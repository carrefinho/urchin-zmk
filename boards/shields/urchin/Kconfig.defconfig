## boards/shields/urchin/Kconfig.defconfig
```kconfig
if URCHIN_LEFT

config ZMK_KEYBOARD_NAME
    default "urchin"

config ZMK_SPLIT_ROLE_CENTRAL
    default y

endif

if URCHIN_LEFT || URCHIN_RIGHT

config ZMK_SPLIT
    default y

endif
```

## boards/shields/urchin/Kconfig.shield
```kconfig
config URCHIN_LEFT
    def_bool $(shields_list_contains,urchin_left)

config URCHIN_RIGHT
    def_bool $(shields_list_contains,urchin_right)
```
